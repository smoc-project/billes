#include "engine.h"
#include "index_html.h"
#include "lwip/apps/fs.h"
#include <string.h>

#define FS_ROOT 0
unsigned char img_favicon[] = { 0x00, 0x00, 0x01, 0x00, 0x01, 0x00, 0x10, 0x10,
    0x00, 0x00, 0x01, 0x00, 0x08, 0x00, 0x68, 0x05, 0x00, 0x00, 0x16, 0x00,
    0x00, 0x00, 0x28, 0x00, 0x00, 0x00, 0x10, 0x00, 0x00, 0x00, 0x20, 0x00,
    0x00, 0x00, 0x01, 0x00, 0x08, 0x00, 0x00, 0x00, 0x00, 0x00, 0x00, 0x00,
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    0x00, 0x00, 0x00, 0x00, 0x00, 0x00 };
unsigned long img_favicon_size = 1406;
const char hello1[] = "<!DOCTYPE html><html><head><meta charset=\"UTF-8\"/></head><body>"
                      "<p>Hello world: ";
const char hello2[] = "</p>"
                      "</body></html>";
const char ok[] = "<!DOCTYPE html><html><head><meta charset=\"UTF-8\"/></head><body>"
                  "<p>OK</p>"
                  "</body></html>";
int fs_open_custom(struct fs_file* file, const char* name) {
    int len = 0;
    file->flags = 0;
    if (strcmp(name, "/favicon.ico") == 0) {
        len = img_favicon_size;
        file->data = (const char*)img_favicon;
    } else if (strcmp(name, "/engine.js") == 0) {
        file->data = engine_data;
        len = engine_data_length;
    } else if (strcmp(name, "/game.html") == 0) {
        file->data = index_html_data;
        len = index_html_data_length;
    } else if (strcmp(name, "/orange.html") == 0) {
        HAL_GPIO_TogglePin(GPIOD, LD3_Pin);
        file->data = ok;
        len = strlen(ok);
    } else if (strcmp(name, "/green.html") == 0) {
        HAL_GPIO_TogglePin(GPIOD, LD4_Pin);
        file->data = ok;
        len = strlen(ok);
    } else if (strcmp(name, "/red.html") == 0) {
        HAL_GPIO_TogglePin(GPIOD, LD5_Pin);
        file->data = ok;
        len = strlen(ok);
    } else if (strcmp(name, "/blue.html") == 0) {
        HAL_GPIO_TogglePin(GPIOD, LD6_Pin);
        file->data = ok;
        len = strlen(ok);
    } else {
        len = strlen(hello1) + strlen(hello2) + strlen(name);
        file->data = (char*)malloc(len + 1);

        strcpy((char*)file->data, hello1);

        strcat((char*)file->data, name);

        strcat((char*)file->data, hello2);

        file->flags |= 0x04;
    }
    file->len = len;
    file->index = len;
    file->pextension = 0;
    return len;
}
/*-----------------------------------------------------------------------------*/
void fs_close_custom(struct fs_file* file) {
    if (file->flags & 0x04) {
        free((char*)file->data);
    }
    file->data = 0;
    file->len = 0;
}
